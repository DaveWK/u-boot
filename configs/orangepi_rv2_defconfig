## configs/orangepi_rv2_defconfig
```kconfig
CONFIG_RISCV=y
CONFIG_SYS_MALLOC_LEN=0x1000000
CONFIG_SYS_MALLOC_F_LEN=0x10000
CONFIG_NR_DRAM_BANKS=2
CONFIG_HAS_CUSTOM_SYS_INIT_SP_ADDR=y
CONFIG_CUSTOM_SYS_INIT_SP_ADDR=0x1000000
CONFIG_DEFAULT_DEVICE_TREE="spacemit/k1-orangepi-rv2"
CONFIG_OF_LIST="spacemit/k1-orangepi-rv2"
CONFIG_SPL_SYS_MALLOC_F_LEN=0x4000
CONFIG_SPL_STACK=0xc083fb00
CONFIG_SPL_TEXT_BASE=0xc0801000
CONFIG_SPL_BSS_START_ADDR=0xc083fc00
CONFIG_SPL_BSS_MAX_SIZE=0x400
CONFIG_SPL_STACK_R=y
CONFIG_SPL_STACK_R_ADDR=0xc00000
CONFIG_SPL_SYS_MALLOC_SIMPLE=y
CONFIG_SPL_STACK_R_MALLOC_SIMPLE_LEN=0x100000
CONFIG_SYS_BOOTM_LEN=0xa000000
CONFIG_SYS_LOAD_ADDR=0x200000
CONFIG_SPL_SIZE_LIMIT=0x31000
CONFIG_SPL=y
CONFIG_DEBUG_UART_BASE=0xd4017000
CONFIG_DEBUG_UART_CLOCK=14700000
CONFIG_TARGET_SPACEMIT_K1=y
CONFIG_ARCH_RV64I=y
CONFIG_RISCV_SMODE=y
CONFIG_RISCV_ISA_ZICBOM=y
CONFIG_SPL_RISCV_MMODE=y
# CONFIG_SPL_SMP is not set
CONFIG_STACK_SIZE=0x100000
CONFIG_EFI_VARIABLE_NO_STORE=y
CONFIG_EFI_LOADER_BOUNCE_BUFFER=y
CONFIG_FIT=y
CONFIG_MULTI_DTB_FIT=y
CONFIG_SPL_HAS_LOAD_FIT_ADDRESS=y
CONFIG_SPL_LOAD_FIT_ADDRESS=0x08000000
CONFIG_SUPPORT_RAW_INITRD=y
CONFIG_BOOTSTD_FULL=y
CONFIG_OF_BOARD_SETUP=y
CONFIG_SYS_CBSIZE=256
CONFIG_SYS_PBSIZE=276
CONFIG_BOARD_INIT=y
CONFIG_SPL_MAX_SIZE=0x33000
# CONFIG_SPL_SHARES_INIT_SP_ADDR is not set
CONFIG_SPL_HAVE_INIT_STACK=y
CONFIG_SPL_I2C=y
CONFIG_SYS_MMCSD_FS_BOOT_PARTITION=3
CONFIG_SPL_DM_RESET=y
CONFIG_SPL_POWER=y
CONFIG_HUSH_PARSER=y
CONFIG_ID_EEPROM=y
CONFIG_CMD_TLV_EEPROM=y
CONFIG_SPL_CMD_TLV_EEPROM=y
CONFIG_OF_UPSTREAM=y
CONFIG_ENV_OVERWRITE=y
CONFIG_ENV_SOURCE_FILE="orangepi-rv2"
CONFIG_SPL_DM_SEQ_ALIAS=y
CONFIG_SPL_REGMAP=y
CONFIG_SPL_SYSCON=y
CONFIG_CLK=y
CONFIG_CLK_CCF=y
CONFIG_SPL_CLK=y
CONFIG_SPL_CLK_CCF=y
CONFIG_CLK_SPACEMIT=y
CONFIG_CLK_SPACEMIT_K1=y
CONFIG_DM_I2C=y
CONFIG_SYS_I2C_SPACEMIT_K1=y
CONFIG_MISC=y
CONFIG_I2C_EEPROM=y
CONFIG_SPL_I2C_EEPROM=y
CONFIG_PINCTRL=y
CONFIG_PINCTRL_SPACEMIT_K1=y
CONFIG_GPIO=y
CONFIG_DM_GPIO=y
CONFIG_CMD_GPIO=y
CONFIG_SPACEMIT_GPIO=y
CONFIG_DM_PMIC=y
CONFIG_PMIC_SPACEMIT_P1=y
CONFIG_DM_REGULATOR=y
CONFIG_SPL_DM_REGULATOR=y
CONFIG_DM_REGULATOR_SPACEMIT_P1=y
CONFIG_DM_REGULATOR_FIXED=y
CONFIG_DEBUG_UART_NS16550=y
CONFIG_DEBUG_UART_SHIFT=2
CONFIG_DEBUG_UART_ANNOUNCE=y
CONFIG_SYS_NS16550=y
CONFIG_SYS_NS16550_MEM32=y
CONFIG_TIMER_EARLY=y
CONFIG_SPL_LIB_RATIONAL=y
CONFIG_SPL_DM_SPI=y
CONFIG_SPL_DM_SPI_FLASH=y
CONFIG_SPACEMIT_K1_DDR=y
CONFIG_MMC=y
CONFIG_DM_MMC=y
CONFIG_MMC_SDHCI=y
CONFIG_MMC_SDHCI_SPACEMIT=y
CONFIG_SPL_MMC=y
CONFIG_SPL_LIBDISK_SUPPORT=y
CONFIG_SPL_FS_FAT=y
CONFIG_CMD_MMC=y
CONFIG_PCI=y
CONFIG_PCIE_DW_SPACEMIT=y
CONFIG_PHY=y
CONFIG_PHY_SPACEMIT_K1_PCIE=y
CONFIG_NVME_PCI=y
CONFIG_CMD_PCI=y
CONFIG_NET=y
CONFIG_DM_ETH=y
CONFIG_SPACEMIT_K1_EMAC=y
CONFIG_PHY_MOTORCOMM=y
CONFIG_CMD_NET=y
CONFIG_RAM=y
CONFIG_SPL_RAM=y
CONFIG_PHY_SPACEMIT_K1_USB2=y
CONFIG_USB=y
CONFIG_USB_XHCI_HCD=y
CONFIG_USB_DWC3=y
CONFIG_USB_DWC3_GENERIC=y
CONFIG_USB_DWC3_SPACEMIT=y
CONFIG_USB_STORAGE=y
CONFIG_CMD_USB=y
```

## drivers/ddr/spacemit/Kconfig
```kconfig
# SPDX-License-Identifier: GPL-2.0+

config SPACEMIT_K1_DDR
	bool "DDR init for SpacemiT K1 (LPDDR4X)"
	depends on SPACEMIT_K1
	help
	  Build the LPDDR4X silicon init and frequency-switch code for the
	  SpacemiT K1 SoC into U-Boot SPL. Required if you want SPL to bring
	  up DRAM directly (i.e. boot without the SpacemiT FSBL).

config SPL_SPACEMIT_K1_DDR
	bool "DDR init for SpacemiT K1 in SPL"
	depends on SPL && SPACEMIT_K1_DDR
	default y
	help
	  Build the K1 DDR init code into U-Boot SPL. This is the phase
	  where DDR is actually programmed; U-Boot proper does not need
	  this code.

config K1_X_BOARD_ASIC
	bool "Spacemit K1 ASIC code path"
	depends on SPACEMIT_K1_DDR
	default y
	help
	  Selects the ASIC (production silicon) code path inside the
	  lifted vendor DDR init, instead of the FPGA emulator paths.

config SPACEMIT_K1_DDR_QOS
	bool "Spacemit K1 DDR QoS programming"
	depends on SPACEMIT_K1_DDR
	help
	  Program the K1 DDR QoS table from SPL.

config SPACEMIT_K1_DDR_FREQ_SWITCH
	bool "Spacemit K1 DDR runtime frequency switching"
	depends on SPACEMIT_K1_DDR
	help
	  Allow runtime DDR clock frequency changes from U-Boot proper
	  (DYNAMIC_DDR_CLK_FREQ).
```

## drivers/net/spacemit/Kconfig
```kconfig
# SPDX-License-Identifier: GPL-2.0+

config SPACEMIT_K1_EMAC
	bool "SpacemiT K1 Ethernet MAC support"
	depends on TARGET_SPACEMIT_K1
	select DM_DMA
	select DM_ETH_PHY
	select DM_MDIO
	select PHYLIB
	select PHY_GIGE
	help
	  Enable support for the Ethernet MAC integrated in the SpacemiT K1.
	  The controller supports 10/100/1000 Mbps links through RGMII and
	  10/100 Mbps links through RMII. Its internal MDIO controller is
	  exposed through the driver-model MDIO uclass.
```
