// SPDX-License-Identifier: GPL-2.0-or-later OR MIT

#include "k1-orangepi-u-boot.dtsi"

/ {
	aliases {
		mmc0 = &emmc;
	};
};

/* Retained initial single-rank DDR workarounds; removal is follow-up work. */
&{/soc} {
	dramc: ddr@c0000000 {
		compatible = "spacemit,k1-ddr";
		reg = <0x0 0xc0000000 0x0 0x400000>;
		datarate = <2400>;
		cs-num = <1>;
		type = "LPDDR4X";
		bootph-pre-ram;
	};
};
